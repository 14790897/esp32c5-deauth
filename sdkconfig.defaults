## sdkconfig.defaults
```kconfig
CONFIG_IDF_TARGET="esp32c5"
CONFIG_ESPTOOLPY_FLASHSIZE_4MB=y
CONFIG_ESP_PHY_REDUCE_TX_POWER=y
CONFIG_ESP_CONSOLE_USB_SERIAL_JTAG=y
CONFIG_ESP_CONSOLE_SECONDARY_NONE=y
CONFIG_PARTITION_TABLE_SINGLE_APP_LARGE=y
CONFIG_LOG_DEFAULT_LEVEL_INFO=y
```
